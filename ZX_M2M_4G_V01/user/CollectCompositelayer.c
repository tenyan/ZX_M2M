/*
 * Copyright(c)2019, 江苏徐工信息技术股份有限公司-智能硬件事业部
 * All right reserved 
 * 
 * 文件名称: CollectCompositelayer.c
 * 版本号  : V1.0
 * 文件标识: 
 * 文件描述: 本文件为开关量采集功能模块综合层的实现文件
 *
 *-----------------------------------------------------------------------------
 * 修改记录
 *-----------------------------------------------------------------------------
 *
 * 2019-03-18,lxf, 创建本文件
 *
 */
 
 //-----头文件调用------------------------------------------------------------
#include "config.h"
#include "CollectCompositelayer.h"
#include "CollectInterfaceLayer.h"
#include "CollectHW.h"


 //-----外部变量定义------------------------------------------------------------
 extern struct STU_Sysstruct STU_Systemstate,STU_SystemstatePre;


 //-----内部变量定义------------------------------------------------------------


 
 //-----内部函数声明------------------------------------------------------------
 
 
 
 //-----外部函数定义------------------------------------------------------------
/*********************************************************************************************************
** 函数名称: Task10ms
** 功能描述: //10ms执行一次的任务
** 输　	 入 : 无
** 输　	 出 : 无
** 全局变量: 
** 调用模块: 
** 作　	 者 : 
** 日　	 期 : 2019年03 月19 日
**------------------------------------------------------------------------------------------------------
********************************************************************************************************/
void Task10ms(void)    
{
	 MCU_TimerCount_NoDelay();//MCU模块计时函数，此函数10ms执行一次
	 SYS_TimerCount_NoDelay();//System模块计时函数
	 //GSM_TimerCount_NODelay();//GSM模块计时函数
	 GPS_TimerCount_NoDelay();
}
 
/*********************************************************************************************************
** 函数名称: SwitchInit
** 功能描述: //10ms执行一次的任务
** 输　  入 : 无
** 输　  出 : 无
** 全局变量: 
** 调用模块: 
** 作　  者 : 
** 日　  期 : 2019年03 月19 日
**------------------------------------------------------------------------------------------------------
********************************************************************************************************/
void SwitchInit(void)
{
    STU_Systemstate.ucSwitch1=0;    // 用于报警开关、ACC开关、小时计开关、搭铁等状态标识
	STU_Systemstate.ucSwitch2=0;    // 用于继电器锁车、开盒报警、CAN、RS23通信状态标识  
	STU_Systemstate.ucSwitch3=0;    // 用于供电方式、外电和内部电池状态、行驶速度、位置越界等状态标识 
}

#if 0
//容许延迟的定时执行函数:10ms
void Collect_TimerCount_Delay()
{
	static uint8 ucCount50ms=50;		/* 50ms计数*/
	static uint8 ucCount500ms=5;

	if(!(--ucCount500ms))
	{
        ucCount500ms = 5;
        //SYS_POWERLED_Display();		
	}
	if(!(--ucCount50ms))
    {
        ucCount50ms=50;
		//ADConvert();                	//电源的采集
	}
}
#endif
/*********************************************************************************************************
** 函数名称: pthread_Collect_Function
** 功能描述: 此任务用来定位调度采集函数，采集外部开关量状态、电压和电池电压等
** 输　  出: 无
** 全局变量: 
** 调用模块: 
** 作　	 者 : 
** 日　	 期 : 2019年03 月18 日

**------------------------------------------------------------------------------------------------------
********************************************************************************************************/
void* pthread_Collect_Function(void *data)
{
    static uint8 ucCount100ms=10;                 /* 100ms计数*/
	static uint8 ucCount500ms=50;                 /* 100ms计数*/
    static uint8 ucCount1s=100;                   /* 1s计数*/

    data = data;

	SwitchInit();
	InitWorktime();	
//	Watchdog_Init();
    SYS_ParamRead();
	while(1)				  
    {
        usleep(One_MilliSecond*10);       //10ms 延时
		Task10ms();                       //10ms执行一次的任务
		if(!(--ucCount100ms))
        {
            ucCount100ms=10;
		
    		MCU_TimerCount_Delay();        //100ms循环
            SYS_SendNetData();
		}
		
		if(!(--ucCount500ms))
		{
			ucCount500ms=50;             	//500ms计数
	
		}
        if(!(--ucCount1s))                 	//每1S中对采集的电压进行处理一次
        {
            ucCount1s=100;   
	
         // CountWorkTime();
		//	InputVoltageCheck();
		//	BatVoltageCheck();
	
			ReportSwitchState();
			Sys_GPSState_Change();   
			//McuFirmwareTimerOut();
			MCU_SendCorePlateData(0x02);
		//	A5Uart0_TimingSendClock();   //定时为MCU校时
		//	Watchdog_Feed();        //喂狗
        }
     }
}






//-----文件CollectCompositelayer.c结束---------------------------------------------



